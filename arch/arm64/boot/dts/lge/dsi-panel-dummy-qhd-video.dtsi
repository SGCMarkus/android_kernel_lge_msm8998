/* Copyright (c) 2014, Code Aurora Forum. All rights reserved.
 *
 * This program is free software; you can redistribute it and/or modify
 * it under the terms of the GNU General Public License version 2 and
 * only version 2 as published by the Free Software Foundation.
 *
 * This program is distributed in the hope that it will be useful,
 * but WITHOUT ANY WARRANTY; without even the implied warranty of
 * MERCHANTABILITY or FITNESS FOR A PARTICULAR PURPOSE.  See the
 * GNU General Public License for more details.
 */
/* Copyright (c) 2014, Code Aurora Forum. All rights reserved.
 *
 * This program is free software; you can redistribute it and/or modify
 * it under the terms of the GNU General Public License version 2 and
 * only version 2 as published by the Free Software Foundation.
 *
 * This program is distributed in the hope that it will be useful,
 * but WITHOUT ANY WARRANTY; without even the implied warranty of
 * MERCHANTABILITY or FITNESS FOR A PARTICULAR PURPOSE.  See the
 * GNU General Public License for more details.
 */

&mdss_mdp {
    dsi_dummy_qhd_video: qcom,mdss_dsi_dummy_dsc_qhd_video {
        qcom,mdss-dsi-panel-name = "dummy video mode dsi no panel";
		qcom,mdss-dsi-panel-type = "dsi_video_mode";
		qcom,mdss-dsi-panel-framerate = <60>;
		qcom,mdss-dsi-virtual-channel-id = <0>;
		qcom,mdss-dsi-stream = <0>;
		qcom,mdss-dsi-panel-width = <1440>;
		qcom,mdss-dsi-panel-height = <2880>;
		qcom,mdss-dsi-h-front-porch = <92>;
		qcom,mdss-dsi-h-back-porch = <48>;
		qcom,mdss-dsi-h-pulse-width = <32>;
		qcom,mdss-dsi-h-sync-skew = <0>;
		qcom,mdss-dsi-v-back-porch = <25>;
		qcom,mdss-dsi-v-front-porch = <10>;
		qcom,mdss-dsi-v-pulse-width = <1>;
		qcom,mdss-dsi-h-left-border = <0>;
		qcom,mdss-dsi-h-right-border = <0>;
		qcom,mdss-dsi-v-top-border = <0>;
		qcom,mdss-dsi-v-bottom-border = <0>;
		qcom,mdss-dsi-bpp = <24>;
		qcom,mdss-dsi-underflow-color = <0xff>;
		qcom,mdss-dsi-border-color = <0>;
		qcom,mdss-dsi-h-sync-pulse = <0>;
		qcom,mdss-dsi-traffic-mode = "burst_mode";
		qcom,mdss-dsi-lane-map = "lane_map_0123";
		qcom,mdss-dsi-bllp-eof-power-mode;
		qcom,mdss-dsi-bllp-power-mode;
		qcom,mdss-dsi-lane-0-state;
		qcom,mdss-dsi-lane-1-state;
		qcom,mdss-dsi-lane-2-state;
		qcom,mdss-dsi-lane-3-state;
		qcom,mdss-dsi-reset-sequence = <1 10>, <0 2>, <1 10>;
		qcom,mdss-dsi-lp11-init;
		qcom,mdss-dsi-tx-eot-append;
		qcom,mdss-mdp-transfer-time-us = <15000>;
		qcom,ulps-enabled;
		qcom,panel-allow-phy-poweroff;
		qcom,mdss-dsi-force-clock-lane-hs = <1>;

		qcom,mdss-dsi-on-command = [05 01 00 00 14 00 02 29 00];
		qcom,mdss-dsi-off-command = [05 01 00 00 78 00 02 28 00];
		qcom,mdss-dsi-post-panel-on-command = [05 01 00 00 14 00 02 29 00];
		lge,mdss-dsi-disp-ctrl-command-1 = [05 01 00 00 14 00 02 29 00];
		lge,mdss-dsi-disp-ctrl-command-1-state = "dsi_hs_mode";
		lge,mdss-dsi-disp-ctrl-command-2 = [05 01 00 00 14 00 02 29 00];
		lge,mdss-dsi-disp-ctrl-command-2-state = "dsi_hs_mode";
		lge,mdss-dsi-bc-dim-command = [05 01 00 00 14 00 02 29 00];
		lge,mdss-dsi-bc-default_command = [05 01 00 00 14 00 02 29 00];
		qcom,mdss-dsi-lp-mode-on = [05 01 00 00 14 00 02 29 00];
		qcom,mdss-dsi-lp-mode-off = [05 01 00 00 14 00 02 29 00];
		lge,mdss-dsi-d65-command = [05 01 00 00 14 00 02 29 00];
		lge,mdss-dsi-cm-default-command = [05 01 00 00 14 00 02 29 00];
		qcom,mdss-dsi-on-command-low-power = [05 01 00 00 14 00 02 29 00];
		qcom,mdss-dsi-off-command-low-power = [05 01 00 00 14 00 02 29 00];
		lge,mode-change-cmds-panel-on-to-doze-suspend-low-power = [05 01 00 00 14 00 02 29 00];
		lge,mode-change-cmds-doze-suspend-to-panel-on-low-power = [05 01 00 00 14 00 02 29 00];
		lge,mode-change-cmds-doze-suspend-to-panel-on = [05 01 00 00 14 00 02 29 00];
		lge,mode-change-cmds-doze-suspend-to-doze = [05 01 00 00 14 00 02 29 00];
		lge,mode-change-cmds-panel-on-to-doze-suspend = [05 01 00 00 14 00 02 29 00];
		lge,mode-change-cmds-doze-to-doze-suspend = [05 01 00 00 14 00 02 29 00];
		lge,bist-on-cmds = [05 01 00 00 14 00 02 29 00];
		lge,change-partial-area-cmds = [05 01 00 00 14 00 02 29 00];
		lge,bist-off-cmds = [05 01 00 00 14 00 02 29 00];
		lge,partial-gram-size = [05 01 00 00 14 00 02 29 00];
		lge,internal-test-command-aod = [05 01 00 00 14 00 02 29 00];
		lge,internal-test-command-orbit = [05 01 00 00 14 00 02 29 00];
		lge,internal-test-command-frc = [05 01 00 00 14 00 02 29 00];
		lge,internal-test-command-power-set1 = [05 01 00 00 14 00 02 29 00];
		lge,internal-test-command-power-set2 = [05 01 00 00 14 00 02 29 00];
		lge,internal-test-command-power-set3 = [05 01 00 00 14 00 02 29 00];
		lge,memory-error-detect-command = [05 01 00 00 14 00 02 29 00];
		lge,esd-detect-command = [05 01 00 00 14 00 02 29 00];
		lge,digital-gamma-cmds-2500K = [05 01 00 00 14 00 02 29 00];
		lge,digital-gamma-cmds-3000K = [05 01 00 00 14 00 02 29 00];
		lge,digital-gamma-cmds-3500K = [05 01 00 00 14 00 02 29 00];
		lge,digital-gamma-cmds-4000K = [05 01 00 00 14 00 02 29 00];
		lge,digital-gamma-cmds-4500K = [05 01 00 00 14 00 02 29 00];
		lge,digital-gamma-cmds-5000K = [05 01 00 00 14 00 02 29 00];
		lge,digital-gamma-cmds-5500K = [05 01 00 00 14 00 02 29 00];
		lge,digital-gamma-cmds-6000K = [05 01 00 00 14 00 02 29 00];
		lge,digital-gamma-cmds-6500K = [05 01 00 00 14 00 02 29 00];
		lge,digital-gamma-cmds-7000K = [05 01 00 00 14 00 02 29 00];
		lge,digital-gamma-cmds-dummy = [05 01 00 00 14 00 02 29 00];

		qcom,mdss-dsi-on-command-state = "dsi_lp_mode";
		qcom,mdss-dsi-off-command-state = "dsi_lp_mode";
		lge,mdss-dsi-hs-command-state = "dsi_hs_mode";

		qcom,mdss-dsi-panel-timings	= [00 14 05 05 08 0E 04 05 04 03 04 00];
		qcom,mdss-dsi-t-clk-post = <0x06>;
		qcom,mdss-dsi-t-clk-pre = <0x20>;
		qcom,mdss-dsi-dma-trigger = "trigger_sw";
		qcom,mdss-dsi-mdp-trigger = "none";

		qcom,compression-mode = "dsc";
		qcom,config-select = <&dsi_dummy_dsc_cmd_config0>;

		qcom,mdss-dsc-version = <0x11>;
		qcom,mdss-dsc-scr-version = <0x1>;

		dsi_dummy_dsc_cmd_config0: config0 {
		        qcom,lm-split = <720 720>;
		        qcom,mdss-dsc-encoders = <2>;
		        qcom,mdss-dsc-slice-height = <16>;
		        qcom,mdss-dsc-slice-width = <720>;
		        qcom,mdss-dsc-slice-per-pkt = <2>;

		        qcom,mdss-dsc-bit-per-component = <8>;
		        qcom,mdss-dsc-bit-per-pixel = <8>;
		        qcom,mdss-dsc-block-prediction-enable;
		};
	};
};
